/* Copyright (c) 2014, The Linux Foundation. All rights reserved.
 *
 * This program is free software; you can redistribute it and/or modify
 * it under the terms of the GNU General Public License version 2 and
 * only version 2 as published by the Free Software Foundation.
 *
 * This program is distributed in the hope that it will be useful,
 * but WITHOUT ANY WARRANTY; without even the implied warranty of
 * MERCHANTABILITY or FITNESS FOR A PARTICULAR PURPOSE.  See the
 * GNU General Public License for more details.
 */

&mdss_mdp {
	dsi_otm1285a_720p_video: qcom,mdss_dsi_otm1285a_720p_video {
		qcom,mdss-dsi-panel-name = "otm1285a 720p video mode dsi panel";
		qcom,mdss-dsi-panel-controller = <&mdss_dsi0>;
		qcom,mdss-dsi-panel-type = "dsi_video_mode";
		qcom,mdss-dsi-panel-destination = "display_1";
		qcom,mdss-dsi-panel-framerate = <60>;
		qcom,mdss-dsi-virtual-channel-id = <0>;
		qcom,mdss-dsi-stream = <0>;
		qcom,mdss-dsi-panel-width = <720>;
		qcom,mdss-dsi-panel-height = <1280>;
		qcom,mdss-dsi-h-front-porch = <112>;
		qcom,mdss-dsi-h-back-porch = <100>;
		qcom,mdss-dsi-h-pulse-width = <24>;
		qcom,mdss-dsi-h-sync-skew = <0>;
		qcom,mdss-dsi-v-back-porch = <20>;
		qcom,mdss-dsi-v-front-porch = <8>;
		qcom,mdss-dsi-v-pulse-width = <4>;
		qcom,mdss-dsi-h-left-border = <0>;
		qcom,mdss-dsi-h-right-border = <0>;
		qcom,mdss-dsi-v-top-border = <0>;
		qcom,mdss-dsi-v-bottom-border = <0>;
		qcom,mdss-dsi-bpp = <24>;
		qcom,mdss-dsi-color-order = "rgb_swap_rgb";
		qcom,mdss-dsi-underflow-color = <0xff>;
		qcom,mdss-dsi-border-color = <0>;
		qcom,mdss-dsi-on-command = [29 01 00 00 00 00 02 00 00
			29 01 00 00 00 00 04 ff 12 85 01
			29 01 00 00 00 00 02 00 80
			29 01 00 00 00 00 03 ff 12 85
			29 01 00 00 00 00 02 00 91
			29 01 00 00 00 00 03 b3 0c 10
			29 01 00 00 00 00 02 00 80
			29 01 00 00 00 00 03 c0 00 7f
			29 01 00 00 00 00 02 00 82
			29 01 00 00 00 00 04 c0 00 0c 08
			29 01 00 00 00 00 02 00 90
			29 01 00 00 00 00 02 c1 66
			29 01 00 00 00 00 02 00 80
			29 01 00 00 00 00 05 c1 1d 1d 1d 1d
			29 01 00 00 00 00 02 00 90
			29 01 00 00 00 00 0b c2 82 02 00 0f 00 81 00 00 0f 00
			29 01 00 00 00 00 02 00 ec
			29 01 00 00 00 00 02 c2 00
			29 01 00 00 00 00 02 00 80
			29 01 00 00 00 00 05 c2 82 01 08 08
			29 01 00 00 00 00 02 00 a0
			29 01 00 00 00 00 08 c0 00 0f 00 00 0b 1f 00
			29 01 00 00 00 00 02 00 fb
			29 01 00 00 00 00 02 c2 00
			29 01 00 00 00 00 02 00 80 
			29 01 00 00 00 00 0d cc 03 04 01 0c 11 0b 0b 0b 0b 0b 0b 0b 
			29 01 00 00 00 00 02 00 b0
			29 01 00 00 00 00 0d cc 04 03 01 11 0c 0b 0b 0b 0b 0b 0b 0b
			29 01 00 00 00 00 02 00 80
			29 01 00 00 00 00 10 cd 0b 0b 0b 0b 0b 0b 0b 0b 0b 12 13 14 0b 0b 0b
			29 01 00 00 00 00 02 00 a0		//新增内容
        		29 01 00 00 00 00 05 cb 00 00 ff 00
			29 01 00 00 00 00 02 00 c0
			29 01 00 00 00 00 10 cb 05 05 05 05 05 00 00 00 00 00 00 00 00 00 00
			29 01 00 00 00 00 02 00 d0
			29 01 00 00 00 00 10 cb 00 00 f0 0f 05 00 05 05 05 00 00 00 00 00 00
			29 01 00 00 00 00 02 00 e0
			29 01 00 00 00 00 05 cc 00 00 00 00 
			29 01 00 00 00 00 02 00 d0
			29 01 00 00 00 00 10 cd 01 02 06 06 06 06 07 08 09 0a 0b 0c 0d 0e 0f
			29 01 00 00 00 00 02 00 e0 
			29 01 00 00 00 00 0d cd 10 11 04 05 03 15 16 17 18 19 1a 1b
			29 01 00 00 00 00 02 00 a0
			29 01 00 00 00 00 10 cd 01 02 06 06 06 06 07 08 09 0a 0b 0c 0d 0e 0f
			29 01 00 00 00 00 02 00 b0
			29 01 00 00 00 00 0d cd 10 11 04 05 03 15 16 17 18 19 1a 1b
			29 01 00 00 00 00 02 00 00
			29 01 00 00 00 00 03 d8 26 26
			29 01 00 00 00 00 02 00 90
			29 01 00 00 00 00 07 c5 b2 d6 a0 0f a0 14
			29 01 00 00 00 00 02 00 96
			29 01 00 00 00 00 05 c5 a0 0d aa 0c
			29 01 00 00 00 00 02 00 c1
			29 01 00 00 00 00 02 c5 73
			29 01 00 00 00 00 02 00 a3
			29 01 00 00 00 00 02 c5 0f
			29 01 00 00 00 00 02 00 a5
			29 01 00 00 00 00 06 c5 0f a0 0d aa 0c
			29 01 00 00 00 00 02 00 93
			29 01 00 00 00 00 02 c5 0f
			29 01 00 00 00 00 02 00 95
			29 01 00 00 00 00 06 c5 0f a0 0d aa 0c
			29 01 00 00 00 00 02 00 90
			29 01 00 00 00 00 0f f5 03 15 09 15 07 15 0c 15 0a 15 09 15 0a 15
			29 01 00 00 00 00 02 00 a0
			29 01 00 00 00 00 0f f5 12 11 03 15 09 15 11 15 08 15 07 15 09 15
			29 01 00 00 00 00 02 00 c0
			29 01 00 00 00 00 0f f5 0e 15 0e 15 00 15 00 15 0e 15 14 11 00 15
			29 01 00 00 00 00 02 00 d0
			29 01 00 00 00 00 10 f5 07 15 0a 15 10 11 00 10 90 90 90 02 90 00 00
			29 01 00 00 00 00 02 00 00
			29 01 00 00 00 00 19 e1 00 12 24 30 3a 41 4d 60 6a 7c 89 92 65 5f 5a 4a 39 28 1c 16 0e 03 01 00
			29 01 00 00 00 00 02 00 00
			29 01 00 00 00 00 19 e2 00 12 24 30 3a 41 4d 60 6a 7c 89 92 65 5f 5a 4a 39 28 1c 16 0e 03 01 00
			29 01 00 00 00 00 02 00 00
			29 01 00 00 00 00 19 e3 00 12 24 30 3a 41 4d 60 6a 7c 89 92 65 5f 5a 4a 39 28 1c 16 0e 03 01 00
			29 01 00 00 00 00 02 00 00
			29 01 00 00 00 00 19 e4 00 12 24 30 3a 41 4d 60 6a 7c 89 92 65 5f 5a 4a 39 28 1c 16 0e 03 01 00
			29 01 00 00 00 00 02 00 00
			29 01 00 00 00 00 19 e5 00 12 24 30 3a 41 4d 60 6a 7c 89 92 65 5f 5a 4a 39 28 1c 16 0e 03 01 00
			29 01 00 00 00 00 02 00 00
			29 01 00 00 00 00 19 e6 00 12 24 30 3a 41 4d 60 6a 7c 89 92 65 5f 5a 4a 39 28 1c 16 0e 03 01 00
			29 01 00 00 00 00 02 00 80
			29 01 00 00 00 00 02 c4 01
			29 01 00 00 00 00 02 00 c2
			29 01 00 00 00 00 02 c5 08
			29 01 00 00 00 00 02 00 a8
			29 01 00 00 00 00 02 c4 10
			29 01 00 00 00 00 02 00 92
			29 01 00 00 00 00 02 E9 10
			29 01 00 00 00 00 02 00 81
			29 01 00 00 00 00 02 C4 24
			29 01 00 00 00 00 02 00 9D
			29 01 00 00 00 00 02 C5 AA
			29 01 00 00 00 00 02 00 b4
			29 01 00 00 00 00 02 c0 40
		 	29 01 00 00 00 00 02 00 B3
        		29 01 00 00 00 00 02 C0 33

        		29 01 00 00 00 00 02 00 8e
			29 01 00 00 00 00 02 cd 1a
		 	29 01 00 00 00 00 02 00 e3
        		29 01 00 00 00 00 02 cc 04

			29 01 00 00 00 00 02 00 b6
			29 01 00 00 00 00 04 cd 16 17 18
			29 01 00 00 00 00 02 00 e6
			29 01 00 00 00 00 04 cd 1b 1b 1b
			29 01 00 00 00 00 02 00 84
			29 01 00 00 00 00 03 c1 f0 e8
			29 01 00 00 00 00 02 00 9a
			29 01 00 00 00 00 04 c5 22 22 20	
		 	29 01 00 00 00 00 02 00 80
        		29 01 00 00 00 00 02 c4 01
		 	29 01 00 00 00 00 02 00 83
        		29 01 00 00 00 00 02 c4 02
			29 01 00 00 00 00 02 00 80
			29 01 00 00 00 00 03 a5 0c 04
		 	29 01 00 00 00 00 02 00 f8
        		29 01 00 00 00 00 02 c2 40
			29 01 00 00 00 00 02 00 f2
			29 01 00 00 00 00 03 c2 04 04
			29 01 00 00 00 00 02 00 fd
			29 01 00 00 00 00 03 c2 cc cf

        		
        		
			29 01 00 00 00 00 02 00 00
			29 01 00 00 00 00 04 ff ff ff ff
			29 01 00 00 00 00 02 35 00
			29 01 00 00 78 00 02 11 00
			29 01 00 00 0a 00 02 29 00];
		qcom,mdss-dsi-off-command = [05 01 00 00 00 00 02 28 00
					05 01 00 00 78 00 02 10 00];
		qcom,mdss-dsi-on-command-state = "dsi_lp_mode";
		qcom,mdss-dsi-off-command-state = "dsi_hs_mode";
		qcom,mdss-dsi-panel-status-command = [06 01 00 01 05 00 02 0A 08];
		qcom,mdss-dsi-panel-status-command-state = "dsi_hs_mode";
		qcom,mdss-dsi-panel-status-check-mode = "reg_read";
		qcom,mdss-dsi-panel-status-value = <0x9c>;
		qcom,mdss-dsi-h-sync-pulse = <1>;
		qcom,mdss-dsi-traffic-mode = "burst_mode";
		qcom,mdss-dsi-lane-map = "lane_map_0123";
		qcom,mdss-dsi-bllp-eof-power-mode;
		qcom,mdss-dsi-bllp-power-mode;
		qcom,mdss-dsi-lane-0-state;
		qcom,mdss-dsi-lane-1-state;
		qcom,mdss-dsi-lane-2-state;
		qcom,mdss-dsi-lane-3-state;
		qcom,mdss-dsi-panel-timings = [92 1C 12 01 42 42 18 20 17 03 04 00];
		qcom,mdss-dsi-t-clk-post = <0x04>;
		qcom,mdss-dsi-t-clk-pre = <0x1C>;
		qcom,mdss-dsi-bl-min-level = <1>;
		qcom,mdss-dsi-bl-max-level = <255>;
		qcom,mdss-dsi-bl-pmic-pwm-frequency = <80>;
		qcom,mdss-dsi-bl-pmic-bank-select = <0>;
		qcom,mdss-dsi-dma-trigger = "trigger_sw";
		qcom,mdss-dsi-mdp-trigger = "none";
		qcom,mdss-dsi-bl-pmic-control-type = "bl_ctrl_pwm";
		qcom,mdss-dsi-reset-sequence = <1 10>, <0 10>, <1 120>;
	};
};
