/* Copyright (c) 2014, The Linux Foundation. All rights reserved.
 *
 * This program is free software; you can redistribute it and/or modify
 * it under the terms of the GNU General Public License version 2 and
 * only version 2 as published by the Free Software Foundation.
 *
 * This program is distributed in the hope that it will be useful,
 * but WITHOUT ANY WARRANTY; without even the implied warranty of
 * MERCHANTABILITY or FITNESS FOR A PARTICULAR PURPOSE.  See the
 * GNU General Public License for more details.
 */

&mdss_mdp {
	dsi_otm8019a_fwvga_video: qcom,mdss_dsi_otm8019a_fwvga_video {
		qcom,mdss-dsi-panel-name = "otm8019a fwvga video mode dsi panel";
		qcom,mdss-dsi-panel-controller = <&mdss_dsi0>;
		qcom,mdss-dsi-panel-type = "dsi_video_mode";
		qcom,mdss-dsi-panel-destination = "display_1";
		qcom,mdss-dsi-panel-framerate = <60>;
		qcom,mdss-dsi-virtual-channel-id = <0>;
		qcom,mdss-dsi-stream = <0>;
		qcom,mdss-dsi-panel-width = <480>;
		qcom,mdss-dsi-panel-height = <854>;
		qcom,mdss-dsi-h-front-porch = <42>;
		qcom,mdss-dsi-h-back-porch = <42>;
		qcom,mdss-dsi-h-pulse-width = <4>;
		qcom,mdss-dsi-h-sync-skew = <0>;
		qcom,mdss-dsi-v-back-porch = <14>;
		qcom,mdss-dsi-v-front-porch = <13>;
		qcom,mdss-dsi-v-pulse-width = <1>;
		qcom,mdss-dsi-h-left-border = <0>;
		qcom,mdss-dsi-h-right-border = <0>;
		qcom,mdss-dsi-v-top-border = <0>;
		qcom,mdss-dsi-v-bottom-border = <0>;
		qcom,mdss-dsi-bpp = <24>;
		qcom,mdss-dsi-color-order = "rgb_swap_rgb";
		qcom,mdss-dsi-underflow-color = <0xff>;
		qcom,mdss-dsi-border-color = <0>;
		qcom,mdss-dsi-on-command = [29 01 00 00 00 00 02 00 00
			29 01 00 00 00 00 04 FF 80 19 01
			29 01 00 00 00 00 02
						00 80
			29 01 00 00 00 00 03
						ff 80 19
			29 01 00 00 00 00 02
						00 03
			29 01 00 00 00 00 02
						ff 01
			29 01 00 00 00 00 02
						00 90
			29 01 00 00 00 00 02
						b3 02
			29 01 00 00 00 00 02
						00 92
			29 01 00 00 00 00 02
						b3 45
			29 01 00 00 00 00 02
						00 A2
			29 01 00 00 00 00 03
						C0 00 1B
			29 01 00 00 00 00 02
						00 80
			29 01 00 00 00 00 0A
						C0 00 58 00 14 16 00 58 14 16
			29 01 00 00 00 00 02
						00 B4
			29 01 00 00 00 00 02
						C0 00
			29 01 00 00 00 00 02
						00 81
			29 01 00 00 00 00 02
						C4 04
			29 01 00 00 00 00 02
						00 8A
			29 01 00 00 00 00 02
						C4 40
			29 01 00 00 00 00 02
						00 80
			29 01 00 00 00 00 04
					       C1 03 33 84
			29 01 00 00 00 00 02
						00 90
			29 01 00 00 00 00 07
						C0 00 15 00 00 00 04
			29 01 00 00 00 00 02
						00 80
			29 01 00 00 00 00 02
						C4 30
			29 01 00 00 00 00 02
						00 A0
			29 01 00 00 00 00 02
						C1 E8
			29 01 00 00 00 00 02
						00 98
			29 01 00 00 00 00 02
						C0 00
			29 01 00 00 00 00 02
						00 A9
			29 01 00 00 00 00 02
						C0 0A
			29 01 00 00 00 00 02
						00 B0
			29 01 00 00 00 00 07
						C1 20 00 00 00 02 01
			29 01 00 00 00 00 02
						00 E1
			29 01 00 00 00 00 03
						C0 40 30
			29 01 00 00 00 00 02
						00 90
			29 01 00 00 00 00 03
						B6 B4 5A
			29 01 00 00 00 00 02
						00 87
			29 01 00 00 00 00 02
						C4 18
			29 01 00 00 00 00 02
						00 89
			29 01 00 00 00 00 02
						C4 08
			29 01 00 00 00 00 02
						00 82
			29 01 00 00 00 00 02
						C5 03
			29 01 00 00 00 00 02
						00 90
			29 01 00 00 00 00 06
						C5 4E 29 00 7B 44
			29 01 00 00 00 00 02
						00 00
			29 01 00 00 00 00 02
						D8 5F
			29 01 00 00 00 00 02
						00 01
			29 01 00 00 00 00 02
						D8 5F
			29 01 00 00 00 00 02
						00 00
	//		29 01 00 00 00 00 02
	//					D9 42
			29 01 00 00 00 00 02
						00 81
			29 01 00 00 00 00 02
						C1 03
			29 01 00 00 00 00 02
						00 A1
			29 01 00 00 00 00 02
						C1 08
			29 01 00 00 00 00 02
						00 B1
			29 01 00 00 00 00 02
						C5 29
			29 01 00 00 00 00 02
						00 00
			29 01 00 00 00 00 15
						E1 1C 26 2F 
						3A 46 53 53 
						7B 6B 84 7F 
						6A 7C 57 53 
						43 35 2B 23 
						1F
			29 01 00 00 00 00 02
						00 00
			29 01 00 00 00 00 15
						E2 1C 27 30
						3A 47 53 54
						7C 6C 85 7F
						6A 7C 57 54
						44 36 2B 23
						1F
			29 01 00 00 00 00 02
						00 80
			29 01 00 00 00 00 0D
						CE 86 01 00
						85 01 00 00
						00 00 00 00
						00
			29 01 00 00 00 00 02
						00 A0
			29 01 00 00 00 00 0F
						CE 18 05 83
						5A 86 04 00
						18 04 83 5B
						86 04 00
			29 01 00 00 00 00 02
						00 B0
			29 01 00 00 00 00 0F
						CE 18 03 83
						5C 86 04 00
						18 02 83 5D
						86 04 00
			29 01 00 00 00 00 02
						00 C0
			29 01 00 00 00 00 0B
						CF 01 01 20
						20 00 00 01
						01 00 00
			29 01 00 00 00 00 02
						00 D0
			29 01 00 00 00 00 02
						CF 00
			29 01 00 00 00 00 02
						00 80
			29 01 00 00 00 00 0B
						CB 00 00 00
						00 00 00 00
						00 00 00
			29 01 00 00 00 00 02
						00 90
			29 01 00 00 00 00 10
						CB 00 00 00
						00 00 00 00
						00 00 00 00
						00 00 00 00
			29 01 00 00 00 00 02
						00 A0
			29 01 00 00 00 00 10
						CB 00 00 00
						00 00 00 00
						00 00 00 00
						00 00 00 00
			29 01 00 00 00 00 02
						00 B0
			29 01 00 00 00 00 0B
						CB 00 00 00
						00 00 00 00
						00 00 00
			29 01 00 00 00 00 02
						00 C0
			29 01 00 00 00 00 10
						CB 00 01 01
						01 01 01 00
						00 00 00 00
						00 00 00 00
			29 01 00 00 00 00 02
						00 D0
			29 01 00 00 00 00 10
						CB 00 00 00
						00 00 00 00
						00 00 00 00
						00 00 00 00
			29 01 00 00 00 00 02
						00 E0
			29 01 00 00 00 00 0B
						CB 01 01 01
						01 01 00 00
						00 00 00
			29 01 00 00 00 00 02
						00 F0
			29 01 00 00 00 00 0B
						CB FF FF FF
						FF FF FF FF
						FF FF FF
			29 01 00 00 00 00 02
						00 80
			29 01 00 00 00 00 0B
						CC 00 26 09
						0B 01 25 00
						00 00 00
			29 01 00 00 00 00 02
						00 90
			29 01 00 00 00 00 10
						CC 00 00 00
						00 00 00 00
						00 00 00 00
						00 00 00 00
			29 01 00 00 00 00 02
						00 A0
			29 01 00 00 00 00 10
						CC 00 00 00
						00 00 25 02
						0C 0A 26 00
						00 00 00 00
			29 01 00 00 00 00 02
						00 B0
			29 01 00 00 00 00 0B
						CC 00 25 0A
						0C 02 26 00
						00 00 00
			29 01 00 00 00 00 02
						00 C0
			29 01 00 00 00 00 10
						CC 00 00 00
						00 00 00 00
						00 00 00 00
						00 00 00 00
			29 01 00 00 00 00 02
						00 D0
			29 01 00 00 00 00 10
						CC 00 00 00
						00 00 26 01
						0B 09 25 00
						00 00 00 00
			29 01 00 00 00 00 02
						00 00
			29 01 00 00 00 00 02
						FB 01
			29 01 00 00 00 00 02
						00 00
			29 01 00 00 00 00 04
						FF FF FF FF
			05 01 00 00 78 00 02 11 00
			05 01 00 00 28 00 02 29 00];
		qcom,mdss-dsi-off-command = [05 01 00 00 0A 00 02 28 00
					05 01 00 00 78 00 02 10 00];
		qcom,mdss-dsi-on-command-state = "dsi_lp_mode";
		qcom,mdss-dsi-off-command-state = "dsi_hs_mode";
		qcom,mdss-dsi-panel-status-command = [06 01 00 01 05 00 02 0A 08];
		qcom,mdss-dsi-panel-status-command-state = "dsi_hs_mode";
		qcom,mdss-dsi-panel-status-check-mode = "reg_read";
		qcom,mdss-dsi-panel-status-value = <0x9c>;
		qcom,mdss-dsi-h-sync-pulse = <1>;
		qcom,mdss-dsi-traffic-mode = "burst_mode";
		qcom,mdss-dsi-lane-map = "lane_map_0123";
		qcom,mdss-dsi-bllp-eof-power-mode;
		qcom,mdss-dsi-bllp-power-mode;
		qcom,mdss-dsi-lane-0-state;
		qcom,mdss-dsi-lane-1-state;
		qcom,mdss-dsi-panel-timings = [9E 1D 15 00 2E 2B 1A 1F 25 03 04 00];
		qcom,mdss-dsi-t-clk-post = <0x20>;
		qcom,mdss-dsi-t-clk-pre = <0x2E>;
		qcom,mdss-dsi-bl-min-level = <1>;
		qcom,mdss-dsi-bl-max-level = <255>;
		qcom,mdss-dsi-dma-trigger = "trigger_sw";
		qcom,mdss-dsi-mdp-trigger = "none";
		qcom,mdss-dsi-bl-pmic-control-type = "bl_ctrl_pwm";
		qcom,mdss-dsi-bl-pmic-pwm-frequency = <30>;
		qcom,mdss-dsi-bl-pmic-bank-select = <0>;
//		qcom,mdss-dsi-pwm-gpio = <&pm8916_mpps 4 0>;     //yajun
		qcom,mdss-dsi-reset-sequence = <1 20>, <0 20>, <1 20>;
	};
};
